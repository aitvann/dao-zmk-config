## config/west.yml
```yaml
manifest:
  remotes:
    - name: zmkfirmware
      url-base: https://github.com/zmkfirmware
  projects:
    - name: zmk
      remote: zmkfirmware
      revision: b80c0be0cedf42b58be2fc431b2a673ab9760c64
      import: app/west.yml
  self:
    path: config
```
